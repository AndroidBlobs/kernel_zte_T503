/ { lcds {
	zte_sturdy_skyworth_st7789v2_spi: lcd7789a1@7789a1 {
		panel-name = "sturdy_skyworth_st7789v2_240*320_2p8_spi";
		zte,lcd-init-code-version = "20190615";
		if-type = <4>;
		spi_bus_num = <1>;
		spi_cs = <0>;
		bpp = <16>;
		fps = <33>;
		spi_mode = <3>; /* SPI_CPHA 0x01 SPI_CPOL 0x02 */
		spi_cd_gpio = <138>;
		spi_te_gpio = <51>;
		spi_pol_mode = <0>;
		spi_endian = <0>;
		spi_freq = <48000000>;
		hactive = <240>;
		vactive = <320>;
		width-mm = <4320>;
		height-mm = <5760>;

		power-on-sequence = <
					50  1  20
					50  0  5
					50  1  120
					>;
		power-off-sequence = <
					50  0  120
					>;

		init-data = [
			ff 78 00 01 11
			ff 00 00 02 36 00
			ff 00 00 02 3a 05
			ff 00 00 06 b2 0c 0c 00 33 33
			ff 00 00 02 b7 75
			ff 00 00 02 bb 1a
			ff 00 00 02 c0 2c
			ff 00 00 02 c2 01
			ff 00 00 02 c3 13
			ff 00 00 02 c4 20
			ff 00 00 02 c6 0f
			ff 00 00 03 d0 a4 a1
			ff 00 00 02 d6 a1
			//ff 00 00 0f e0 70 0d 16 14 14 2f 3a 44 49 3b 17 19 1a 1d
			//ff 00 00 0f e1 70 04 0c 08 09 23 3a 44 49 3b 17 14 1a 1d
			ff 00 00 02 cc 0a
			ff 00 00 02 51 00
			ff 00 00 02 53 2c
			ff 00 00 02 55 00
			ff 00 00 01 35
			ff 00 00 03 44 00 00
			ff 50 00 01 29
			ff 00 00 0f e0 70 0d 16 14 14 2f 3a 44 49 3b 17 19 1a 1d
			ff 00 00 0f e1 70 04 0c 08 09 23 3a 44 49 3b 17 14 1a 1d
			ff 00 00 01 2c
			];
		init-data-v2 = [
			ff 78 00 01 11
			ff 00 00 02 36 00
			ff 00 00 02 3a 05
			ff 00 00 06 b2 0c 0c 00 33 33
			ff 00 00 02 b7 75
			ff 00 00 02 bb 1a
			ff 00 00 02 c0 2c
			ff 00 00 02 c2 01
			ff 00 00 02 c3 13
			ff 00 00 02 c4 20
			ff 00 00 02 c6 0f
			ff 00 00 03 d0 a4 a1
			ff 00 00 02 d6 a1
			ff 00 00 0f e0 70 0d 16 14 14 2f 3a 44 49 3b 17 19 1a 1d
			ff 00 00 0f e1 70 04 0c 08 09 23 3a 44 49 3b 17 14 1a 1d
			ff 00 00 01 35
			ff 00 00 03 44 00 00
			ff 50 00 01 29
			ff 00 00 01 2c
			];

		sleep-in = [
			ff 00 00 01 34
			ff 78 00 01 28
			ff 78 00 01 10
			];
		sleep-out = [
			ff 78 00 01 11
			ff 64 00 01 29
			];
		oled-backlight {
		default-brightness = <102>;
		max-level = <255>;
		brightness-levels = [
			ff 00 00 02 51 00
			ff 00 00 01 2c
			];
		};
	};
};};

